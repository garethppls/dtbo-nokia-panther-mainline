/dts-v1/;

/ {
	model = "Nokia 4.2 (panther)";
	compatible = "nokia,panther", "qcom,sdm439";
	qcom,board-id = <11 2>;

	fragment@0 {
		target-path="/soc/chosen";

		__overlay__ {
			bootargs_ext="test-here";
		};
	};

	__symbols__ {
	};

	__fixups__ {
	};

	__local_fixups__ {
	};
};
